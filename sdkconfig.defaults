## sdkconfig.defaults
```kconfig
# Override flash size to match Arduino Nano ESP32 hardware (16MB)
CONFIG_ESPTOOLPY_FLASHSIZE_2MB=n
CONFIG_ESPTOOLPY_FLASHSIZE_16MB=y
CONFIG_ESPTOOLPY_FLASHSIZE="16MB"
```
